/dts-v1/;
/plugin/;

/{
	compatible = "brcm,bcm2835", "brcm,bcm2836", "brcm,bcm2708", "brcm,bcm2709";

	fragment@0 {
		target = <&act_led>;
		frag0: __overlay__ {
			gpios = <&gpio 0 0>;
		};
	};

	__overrides__ {
		gpio = <&frag0>,"gpios:5";
		activelow = <&frag0>,"off";
	};
};
